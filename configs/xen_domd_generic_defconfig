## configs/xen_domd_generic_defconfig
```kconfig
BR2_aarch64=y
BR2_KERNEL_HEADERS_5_10=y
BR2_TARGET_GENERIC_HOSTNAME="guest"
BR2_TARGET_GENERIC_ISSUE="Welcome to Linux Guest"
BR2_SYSTEM_DHCP="eth0"
BR2_LINUX_KERNEL=y
BR2_LINUX_KERNEL_CUSTOM_TARBALL=y
BR2_LINUX_KERNEL_CUSTOM_TARBALL_LOCATION="https://github.com/renesas-rz/rz_linux-cip/archive/refs/heads/rz-5.10-cip54.tar.gz"
BR2_LINUX_KERNEL_USE_ARCH_DEFAULT_CONFIG=y
BR2_LINUX_KERNEL_CONFIG_FRAGMENT_FILES="board/xen_domd/generic/linux-xen.fragment"
BR2_LINUX_KERNEL_NEEDS_HOST_OPENSSL=y
BR2_TARGET_ROOTFS_CPIO_GZIP=y
BR2_TARGET_ROOTFS_EXT2=y
BR2_TARGET_ROOTFS_EXT2_4=y
# BR2_TARGET_ROOTFS_TAR is not set
BR2_PACKAGE_HOST_QEMU=y
BR2_PACKAGE_HOST_QEMU_SYSTEM_MODE=y
```
